## app/boards/shields/minidactyl/Kconfig.defconfig
```kconfig
if SHIELD_MINIDACTYL_LEFT

config ZMK_KEYBOARD_NAME
    default "Minidactyl"

config ZMK_SPLIT_ROLE_CENTRAL
    default y

endif

if SHIELD_MINIDACTYL_LEFT || SHIELD_MINIDACTYL_RIGHT

config ZMK_SPLIT
    default y

endif
```
